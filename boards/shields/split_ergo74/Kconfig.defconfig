## boards/shields/split_ergo74/Kconfig.defconfig
```kconfig
if SHIELD_SPLIT_ERGO74_LEFT

config ZMK_KEYBOARD_NAME
    default "split_ergo74"

endif

if SHIELD_SPLIT_ERGO74_LEFT || SHIELD_SPLIT_ERGO74_RIGHT

config ZMK_SPLIT
    default y

endif
```

## boards/shields/split_ergo74/Kconfig.shield
```kconfig
config SHIELD_SPLIT_ERGO74_LEFT
    def_bool $(shields_list_contains,split_ergo74_left)
config SHIELD_SPLIT_ERGO74_RIGHT
    def_bool $(shields_list_contains,split_ergo74_right)
```
